/*
 * Copyright (c) 2020 The ZMK Contributors
 *
 * SPDX-License-Identifier: MIT
 */

// Source desired key-position labels

#include "zmk-helpers/key-labels/sofle.h"
#include "zmk-helpers/helper.h"


#define KEYS_L LN0 LN1 LN2 LN3 LN4 LN5 LT0 LT1 LT2 LT3 LT4 LT5 LM0 LM1 LM2 LM3 LM4 LM5 LB0 LB1 LB2 LB3 LB4 LB5   // left-hand keys
#define KEYS_R RN0 RN1 RN2 RN3 RN4 RN5 RT0 RT1 RT2 RT3 RT4 RT5 RM0 RM1 RM2 RM3 RM4R RM5 RB0 RB1 RB2 RB3 RB4 RB5  // right-hand keys
#define THUMBS LH4 LH3 LH2 LH1 LH0 RH0 RH1 RH2 RH3 RH4                                                           // thumb keys







// custom modifier combinations
#define LHYP LS(LC(LA(LGUI)))
#define RHYP RS(RC(RA(RGUI)))
#define LMEH LS(LC(LALT))
#define RMEH RS(RC(RALT))

/* Enable keymap features that require forks or modules */
// #define HAS_UROB

#define HAS_TRI_STATE
#define HAS_MOUSE_KEYS
// #define HAS_MOUSE_TP
// #define HAS_CAPSLOCK

/* source the main keymap */
#include "soflebase.keymap"